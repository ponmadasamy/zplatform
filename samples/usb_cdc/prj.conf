## CMakeLists.txt
```
# Copyright (c) 2026 ZPlatform contributors
# SPDX-License-Identifier: Apache-2.0

cmake_minimum_required(VERSION 3.20.0)
find_package(Zephyr REQUIRED HINTS $ENV{ZEPHYR_BASE})
project(usb_cdc)

target_sources(app PRIVATE src/main.c)
```

## sample.yaml
```
sample:
  name: ZPlatform USB CDC sample
tests:
  sample.zplatform.usb_cdc:
    tags: usb
    platform_allow:
      - stm3210e_eval
    harness: console
    harness_config:
      type: multi_line
      regex:
        - "USB CDC sample"
        - "\\[PASS\\] USB"
```

## prj.conf
```kconfig
# Copyright (c) 2026 ZPlatform contributors
# SPDX-License-Identifier: Apache-2.0

CONFIG_GPIO=y
CONFIG_SERIAL=y
CONFIG_CONSOLE=y
CONFIG_UART_CONSOLE=y
CONFIG_USB_DEVICE_STACK=y
CONFIG_USB_DEVICE_STACK_NEXT=n
CONFIG_DEPRECATION_TEST=y
CONFIG_USB_DEVICE_PRODUCT="ZPlatform CDC ACM"
CONFIG_USB_DEVICE_PID=0x0001
CONFIG_USB_DEVICE_INITIALIZE_AT_BOOT=n
CONFIG_UART_INTERRUPT_DRIVEN=y
CONFIG_UART_LINE_CTRL=y
CONFIG_LOG=y
CONFIG_USB_DRIVER_LOG_LEVEL_ERR=y
CONFIG_USB_DEVICE_LOG_LEVEL_ERR=y
```

## src/main.c
```c
/*
 * Copyright (c) 2026 ZPlatform contributors
 * SPDX-License-Identifier: Apache-2.0
 *
 * USB FS CDC ACM on CN14 (UM0488 §2.15). Keep CAN disabled (shared IRQs).
 */

#include <zephyr/kernel.h>
#include <zephyr/device.h>
#include <zephyr/drivers/uart.h>
#include <zephyr/usb/usb_device.h>
#include <zephyr/sys/printk.h>

int main(void)
{
	const struct device *cdc = DEVICE_DT_GET_ONE(zephyr_cdc_acm_uart);
	uint32_t dtr = 0;
	int rc;

	printk("USB CDC sample\n");

	if (!device_is_ready(cdc)) {
		printk("[FAIL] CDC ACM not ready\n");
		return 0;
	}

	rc = usb_enable(NULL);
	if (rc != 0 && rc != -EALREADY) {
		printk("[FAIL] USB enable (%d)\n", rc);
		return 0;
	}

	printk("[PASS] USB CDC ACM (CN14)\n");

	/* Wait for host terminal DTR (optional). */
	while (true) {
		(void)uart_line_ctrl_get(cdc, UART_LINE_CTRL_DTR, &dtr);
		if (dtr) {
			break;
		}
		k_msleep(100);
	}

	printk("Host connected — echo on CDC\n");

	while (1) {
		uint8_t c;

		if (uart_poll_in(cdc, &c) == 0) {
			uart_poll_out(cdc, c);
		}
		k_msleep(5);
	}

	return 0;
}
```
