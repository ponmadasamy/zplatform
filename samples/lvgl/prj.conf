## CMakeLists.txt
```
# Copyright (c) 2026 ZPlatform contributors
# SPDX-License-Identifier: Apache-2.0

cmake_minimum_required(VERSION 3.20.0)
find_package(Zephyr REQUIRED HINTS $ENV{ZEPHYR_BASE})
project(lvgl_splash)

target_sources(app PRIVATE src/main.c)
```

## sample.yaml
```
sample:
  name: ZPlatform LVGL splash
tests:
  sample.zplatform.lvgl:
    tags: lvgl display
    platform_allow:
      - stm3210e_eval
    harness: console
    harness_config:
      type: multi_line
      regex:
        - "\\[PASS\\] EXT_SRAM ready"
        - "\\[PASS\\] LVGL splash"
```

## prj.conf
```kconfig
# Copyright (c) 2026 ZPlatform contributors
# SPDX-License-Identifier: Apache-2.0
#
# MB895 splash via LVGL. Draw buffers + heap in EXT_SRAM (FSMC bank3).

CONFIG_DISPLAY=y
CONFIG_DISPLAY_LOG_LEVEL_ERR=y
CONFIG_GPIO=y
CONFIG_SERIAL=y
CONFIG_CONSOLE=y
CONFIG_UART_CONSOLE=y
CONFIG_LOG=y

CONFIG_ZPLATFORM=y
CONFIG_ZPLATFORM_FSMC_SRAM=y
CONFIG_ZPLATFORM_MB895_LCD=y

CONFIG_LVGL=y
CONFIG_LV_COLOR_DEPTH_16=y
CONFIG_LV_USE_LABEL=y
CONFIG_LV_FONT_MONTSERRAT_14=y
CONFIG_LV_FONT_MONTSERRAT_28=y
CONFIG_LV_Z_MEM_POOL_SIZE=16384
CONFIG_LV_Z_VDB_SIZE=100
CONFIG_LV_Z_FULL_REFRESH=y
CONFIG_LV_Z_VDB_ZEPHYR_REGION=y
CONFIG_LV_Z_VDB_ZEPHYR_REGION_NAME="EXT_SRAM"
CONFIG_LV_Z_MEMORY_POOL_ZEPHYR_REGION=y
CONFIG_LV_Z_MEMORY_POOL_ZEPHYR_REGION_NAME="EXT_SRAM"

CONFIG_MAIN_STACK_SIZE=4096
CONFIG_HEAP_MEM_POOL_SIZE=2048
```

## src/main.c
```c
/*
 * Copyright (c) 2026 ZPlatform contributors
 * SPDX-License-Identifier: Apache-2.0
 *
 * Brand splash sample (logo + palette). Full EVK UI is demo/stm3210e_eval.
 */

#include <zephyr/device.h>
#include <zephyr/drivers/display.h>
#include <zephyr/kernel.h>
#include <zephyr/sys/printk.h>
#include <zephyr/sys/util.h>

#include <lvgl.h>

#include <zplatform/brand.h>
#include <zplatform/fsmc_sram.h>

int main(void)
{
	const struct device *disp = DEVICE_DT_GET(DT_CHOSEN(zephyr_display));
	lv_obj_t *scr;
	lv_obj_t *brand;
	lv_obj_t *tag;
	int rc;

	printk("LVGL splash sample\n");

	if (!device_is_ready(disp)) {
		printk("[FAIL] display not ready\n");
		return 0;
	}

	if (!zplatform_fsmc_sram_ready() &&
	    zplatform_fsmc_sram_init() != 0) {
		printk("[FAIL] FSMC SRAM init\n");
		return 0;
	}
	printk("[PASS] EXT_SRAM ready for LVGL buffers\n");

	scr = lv_screen_active();
	lv_obj_set_style_bg_color(scr, lv_color_hex(ZPLATFORM_COLOR_MIDNIGHT), 0);
	lv_obj_set_style_bg_opa(scr, LV_OPA_COVER, 0);

	brand = lv_label_create(scr);
	lv_label_set_text(brand, ZPLATFORM_BRAND_NAME);
	lv_obj_set_style_text_font(brand, &lv_font_montserrat_28, 0);
	lv_obj_set_style_text_color(brand, lv_color_hex(ZPLATFORM_COLOR_SNOW), 0);
	lv_obj_align(brand, LV_ALIGN_CENTER, 0, -20);

	tag = lv_label_create(scr);
	lv_label_set_text(tag, ZPLATFORM_BRAND_TAGLINE);
	lv_obj_set_style_text_font(tag, &lv_font_montserrat_14, 0);
	lv_obj_set_style_text_color(tag, lv_color_hex(ZPLATFORM_COLOR_CYAN), 0);
	lv_obj_align(tag, LV_ALIGN_CENTER, 0, 16);

	lv_timer_handler();
	rc = display_blanking_off(disp);
	if (rc < 0 && rc != -ENOSYS) {
		printk("[FAIL] blanking_off (%d)\n", rc);
		return 0;
	}

	printk("[PASS] LVGL splash on MB895\n");

	while (1) {
		uint32_t sleep_ms = lv_timer_handler();

		k_msleep(sleep_ms == 0U ? 5U : MIN(sleep_ms, 50U));
	}
}
```
