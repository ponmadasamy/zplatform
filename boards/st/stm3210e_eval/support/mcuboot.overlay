/*
 * Copyright (c) 2026 ZPlatform contributors
 * SPDX-License-Identifier: Apache-2.0
 *
 * MCUboot bootloader image: multi-slot map + link into boot_partition.
 */

#include "partitions_mcuboot.dtsi"

/ {
	chosen {
		zephyr,code-partition = &boot_partition;
	};
};
