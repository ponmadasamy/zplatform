/*
 * Copyright (c) 2026 ZPlatform contributors
 * SPDX-License-Identifier: Apache-2.0
 *
 * Application image for MCUboot: multi-slot map + link into slot0.
 */

#include "support/partitions_mcuboot.dtsi"

/ {
	chosen {
		zephyr,code-partition = &slot0_partition;
	};
};
