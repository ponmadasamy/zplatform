## CMakeLists.txt
```
cmake_minimum_required(VERSION 3.20.0)
find_package(Zephyr REQUIRED HINTS $ENV{ZEPHYR_BASE})
project(dummy_driver_test)

target_sources(app PRIVATE src/main.c)
```

## prj.conf
```kconfig
CONFIG_ZTEST=y
CONFIG_ZPLATFORM=y
```

## src/main.c
```c
/*
 * Copyright (c) 2026 ZPlatform contributors
 * SPDX-License-Identifier: Apache-2.0
 *
 * Placeholder driver-suite entry so Twister discovers tests/drivers/.
 * Replace with real out-of-tree driver tests as drivers are added.
 */

#include <zephyr/ztest.h>

ZTEST(zplatform_drivers_dummy, test_placeholder)
{
	zassert_true(true, "placeholder");
}

ZTEST_SUITE(zplatform_drivers_dummy, NULL, NULL, NULL, NULL, NULL);
```
