## CMakeLists.txt
```
# Copyright (c) 2026 ZPlatform contributors
# SPDX-License-Identifier: Apache-2.0

cmake_minimum_required(VERSION 3.20.0)
find_package(Zephyr REQUIRED HINTS $ENV{ZEPHYR_BASE})
project(zplatform_demo_stm3210e_eval)

target_include_directories(app PRIVATE src assets)

target_sources(app PRIVATE
  src/demo.c
  src/demo_gpio.c
  src/demo_peripherals.c
  src/demo_diag.c
  src/ui/ui_nav.c
  src/ui/ui_splash.c
  src/ui/ui_io.c
  src/ui/ui_peri.c
  src/ui/ui_threads.c
  assets/logo_splash.c
)
```

## sample.yaml
```
sample:
  name: ZPlatform demo (stm3210e_eval)
tests:
  demo.stm3210e_eval:
    tags: zplatform demo
    platform_allow:
      - stm3210e_eval
    harness: console
    harness_config:
      type: multi_line
      regex:
        - "ZPlatform Demo"
        - "ZPlatform ready"
```

## prj.conf
```kconfig
# Copyright (c) 2026 ZPlatform contributors
# SPDX-License-Identifier: Apache-2.0

CONFIG_GPIO=y
CONFIG_SERIAL=y
CONFIG_CONSOLE=y
CONFIG_UART_CONSOLE=y
CONFIG_UART_INTERRUPT_DRIVEN=y
CONFIG_SHELL=y
CONFIG_SHELL_BACKEND_SERIAL=y
CONFIG_LOG=y
CONFIG_LOG_DEFAULT_LEVEL=3
CONFIG_I2C=y
CONFIG_SPI=y
CONFIG_FLASH=y
CONFIG_SPI_NOR=y
CONFIG_FLASH_JESD216_API=y
CONFIG_FLASH_MAP=y
CONFIG_FLASH_PAGE_LAYOUT=y
CONFIG_ADC=y
CONFIG_PWM=y
CONFIG_DAC=y
CONFIG_COUNTER=y
CONFIG_CAN=y
CONFIG_SENSOR=y
CONFIG_LM75=y
CONFIG_DISPLAY=y
CONFIG_THREAD_MONITOR=y
CONFIG_INIT_STACKS=y
CONFIG_THREAD_STACK_INFO=y
CONFIG_THREAD_NAME=y
CONFIG_THREAD_RUNTIME_STATS=y
CONFIG_SCHED_THREAD_USAGE=y
CONFIG_SCHED_THREAD_USAGE_ANALYSIS=y
CONFIG_ZPLATFORM=y
CONFIG_ZPLATFORM_LIB_COMMON=y
CONFIG_ZPLATFORM_LIB_DIAGNOSTICS=y
CONFIG_ZPLATFORM_SHELL=y
CONFIG_ZPLATFORM_FSMC_SRAM=y
CONFIG_ZPLATFORM_SDIO_SD=y
CONFIG_ZPLATFORM_MB895_LCD=y

CONFIG_LVGL=y
CONFIG_LV_COLOR_DEPTH_16=y
CONFIG_LV_USE_LABEL=y
CONFIG_LV_USE_BAR=y
CONFIG_LV_USE_IMAGE=y
CONFIG_LV_FONT_MONTSERRAT_12=y
CONFIG_LV_FONT_MONTSERRAT_14=y
CONFIG_LV_FONT_MONTSERRAT_20=y
CONFIG_LV_Z_MEM_POOL_SIZE=49152
CONFIG_LV_Z_VDB_SIZE=25
CONFIG_LV_Z_FULL_REFRESH=n
CONFIG_LV_Z_VDB_ZEPHYR_REGION=y
CONFIG_LV_Z_VDB_ZEPHYR_REGION_NAME="EXT_SRAM"
CONFIG_LV_Z_MEMORY_POOL_ZEPHYR_REGION=y
CONFIG_LV_Z_MEMORY_POOL_ZEPHYR_REGION_NAME="EXT_SRAM"

CONFIG_MAIN_STACK_SIZE=8192
CONFIG_IDLE_STACK_SIZE=512
CONFIG_SHELL_STACK_SIZE=2048
CONFIG_HEAP_MEM_POOL_SIZE=4096
CONFIG_SYSTEM_WORKQUEUE_STACK_SIZE=2048
```

## prj_mcuboot.conf
```kconfig
# Copyright (c) 2026 ZPlatform contributors
# SPDX-License-Identifier: Apache-2.0
#
# Extra Kconfig when building under MCUboot (slot0 layout).
# Applied via EXTRA_CONF_FILE from build.ps1 / build.sh.
#
# west build signs zephyr.bin -> zephyr.signed.bin via imgtool when
# CONFIG_MCUBOOT_SIGNATURE_KEY_FILE is set. Scripts pass
# -DZPLATFORM_ROOT so CMake expands ${ZPLATFORM_ROOT} below.
#
# --pad is required so the image trailer sits at the end of the slot.
# For BOOT_SWAP_USING_MOVE with equal 448 KiB slots, pad to the full
# partition (0x70000); the move sector is managed inside that slot.
# Do NOT pad to a smaller size — MCUboot looks for magic at slot end.

CONFIG_STREAM_FLASH=y
CONFIG_IMG_MANAGER=y
CONFIG_MCUBOOT_IMG_MANAGER=y

CONFIG_MCUBOOT_SIGNATURE_KEY_FILE="\${ZPLATFORM_ROOT}/keys/root-ec-p256.pem"
CONFIG_MCUBOOT_IMGTOOL_SIGN_VERSION="1.0.0"
CONFIG_MCUBOOT_EXTRA_IMGTOOL_ARGS="--pad"
```

## prj_profile.conf
```kconfig
# Copyright (c) 2026 ZPlatform contributors
# SPDX-License-Identifier: Apache-2.0

CONFIG_ZPLATFORM_PROFILING=y
CONFIG_THREAD_RUNTIME_STATS=y
CONFIG_INIT_STACKS=y
CONFIG_THREAD_STACK_INFO=y
CONFIG_THREAD_MONITOR=y
CONFIG_SCHED_THREAD_USAGE=y
CONFIG_SCHED_THREAD_USAGE_ANALYSIS=y
```

## boards/stm3210e_eval.overlay
```dts
/*
 * Demo enables bxCAN loopback smoke; USB shares F103 IRQs 19/20 so disable it.
 */
/ {
	chosen {
		zephyr,canbus = &can1;
	};
};

&usb {
	status = "disabled";
};

&can1 {
	status = "okay";
	bitrate = <125000>;
};
```

## src/demo.c
```c
/*
 * Copyright (c) 2026 ZPlatform contributors
 * SPDX-License-Identifier: Apache-2.0
 *
 * STM3210E-EVAL integrated demo: console smoke + LVGL UI.
 */

#include <zephyr/kernel.h>
#include <zephyr/sys/printk.h>
#include <zephyr/version.h>

#if defined(CONFIG_BOOTLOADER_MCUBOOT)
#include <zephyr/dfu/mcuboot.h>
#endif

#include <zplatform/info.h>
#include <zplatform/brand.h>

#include "demo_internal.h"

int main(void)
{
	struct zplatform_sys_info info;

	printk("========================================\n");
	printk(" %s\n", ZPLATFORM_BRAND_NAME);
	printk(" %s\n", ZPLATFORM_BRAND_TAGLINE);
	if (zplatform_get_sys_info(&info) == 0) {
		printk(" %s\n", info.board);
	}
	printk(" %s\n", ZPLATFORM_BRAND_IMPACT);
	printk("========================================\n\n");

	printk("System\n");
	printk(" [PASS] Boot\n");
	printk(" [PASS] Clock (%u Hz)\n",
	       info.cpu_freq_hz ? info.cpu_freq_hz :
				  sys_clock_hw_cycles_per_sec());
	printk(" [PASS] Kernel (%s)\n", KERNEL_VERSION_STRING);
	printk(" [PASS] Console\n");
#if defined(CONFIG_BOOTLOADER_MCUBOOT)
	if (!boot_is_img_confirmed()) {
		int cret = boot_write_img_confirmed();

		if (cret == 0) {
			printk(" [PASS] MCUboot image confirmed\n");
		} else {
			printk(" [FAIL] MCUboot confirm (%d)\n", cret);
		}
	} else {
		printk(" [PASS] MCUboot image already confirmed\n");
	}
#endif
	printk("\n");

	demo_run_gpio();
	demo_run_peripherals();
	demo_run_diagnostics();

	printk("\n%s ready.\n", ZPLATFORM_BRAND_NAME);
	printk("%s\n", ZPLATFORM_BRAND_VISION);
	printk("========================================\n");
	printk("Shell available. Try: zplatform info\n");
	printk("LCD UI: Joy Left/Right change screens\n");

#if defined(CONFIG_LVGL) && defined(CONFIG_BOARD_STM3210E_EVAL)
	demo_ui_run();
#endif

	return 0;
}
```

## src/demo_diag.c
```c
/*
 * Copyright (c) 2026 ZPlatform contributors
 * SPDX-License-Identifier: Apache-2.0
 */

#include <zephyr/kernel.h>
#include <zephyr/sys/printk.h>

#include <zplatform/info.h>
#include <zplatform/diag.h>

#include "demo_internal.h"

void demo_run_diagnostics(void)
{
	struct zplatform_sys_info info;
	char uid[(ZPLATFORM_UID_MAX_LEN * 2) + 1];
	char reset[96];

	if (zplatform_get_sys_info(&info) == 0) {
		(void)zplatform_format_uid(&info, uid, sizeof(uid));
		(void)zplatform_format_reset_cause(info.reset_cause, reset, sizeof(reset));

		printk("System details\n");
		printk(" MCU board: %s\n", info.board);
		printk(" Build: %s %s\n", info.build_date, info.build_time);
		printk(" UID: %s\n", uid);
		printk(" Reset: %s\n", reset);
		printk(" CPU frequency: %u Hz\n", info.cpu_freq_hz);
		printk(" Flash size: %u\n", info.flash_size);
		printk(" RAM size: %u\n", info.sram_size);
		printk(" ZPlatform: %s\n", info.zplatform_version);
		printk(" Zephyr: %s\n", info.zephyr_version);
		printk("\n");
	}

	zplatform_diag_report();
}
```

## src/demo_gpio.c
```c
/*
 * Copyright (c) 2026 ZPlatform contributors
 * SPDX-License-Identifier: Apache-2.0
 */

#include <zephyr/kernel.h>
#include <zephyr/drivers/gpio.h>
#include <zephyr/sys/printk.h>

#include "demo_internal.h"

static const struct gpio_dt_spec button = GPIO_DT_SPEC_GET_OR(DT_ALIAS(sw0), gpios, {0});
static const struct gpio_dt_spec led = GPIO_DT_SPEC_GET_OR(DT_ALIAS(led0), gpios, {0});

void demo_run_gpio(void)
{
	printk("GPIO\n");

	if (button.port && gpio_is_ready_dt(&button) &&
	    gpio_pin_configure_dt(&button, GPIO_INPUT) == 0) {
		printk(" [PASS] USER BUTTON (raw=%d)\n", gpio_pin_get_dt(&button));
	} else {
		printk(" [SKIP] USER BUTTON - not available\n");
	}

	if (led.port && gpio_is_ready_dt(&led) &&
	    gpio_pin_configure_dt(&led, GPIO_OUTPUT_INACTIVE) == 0) {
		gpio_pin_set_dt(&led, 1);
		printk(" [PASS] LED (led0 / LD1 on — full LED UI is samples/gpio)\n");
	} else {
		printk(" [SKIP] LED - not available\n");
	}

	printk("\n");
}
```

## src/demo_internal.h
```c
/*
 * Copyright (c) 2026 ZPlatform contributors
 * SPDX-License-Identifier: Apache-2.0
 */

#ifndef DEMO_INTERNAL_H_
#define DEMO_INTERNAL_H_

#include <stdbool.h>

/** Console smoke: GPIO / buttons / LED. */
void demo_run_gpio(void);

/** Console smoke: buses + tested EVK peripherals. */
void demo_run_peripherals(void);

/** Console smoke: UID / reset / diag. */
void demo_run_diagnostics(void);

#if defined(CONFIG_LVGL)
/** Interactive LVGL UI (splash / IO / peri / threads). Never returns. */
void demo_ui_run(void);
#endif

#endif /* DEMO_INTERNAL_H_ */
```

## src/demo_peripherals.c
```c
/*
 * Copyright (c) 2026 ZPlatform contributors
 * SPDX-License-Identifier: Apache-2.0
 */

#include <zephyr/kernel.h>
#include <zephyr/device.h>
#include <zephyr/drivers/i2c.h>
#include <zephyr/drivers/spi.h>
#include <zephyr/drivers/adc.h>
#include <zephyr/drivers/pwm.h>
#include <zephyr/drivers/dac.h>
#include <zephyr/drivers/counter.h>
#include <zephyr/drivers/can.h>
#include <zephyr/drivers/sensor.h>
#include <zephyr/drivers/display.h>
#include <zephyr/drivers/flash.h>
#include <zephyr/storage/flash_map.h>
#include <zephyr/sys/printk.h>

#include <zplatform/mb895_lcd.h>
#include <zplatform/fsmc_sram.h>
#include <zplatform/sdio_sd.h>

#include "demo_internal.h"

#if DT_HAS_CHOSEN(zephyr_canbus)
CAN_MSGQ_DEFINE(demo_can_rx, 2);
#endif

void demo_run_peripherals(void)
{
	printk("Peripherals\n");

#if DT_NODE_HAS_STATUS(DT_NODELABEL(i2c1), okay)
	{
		const struct device *i2c = DEVICE_DT_GET(DT_NODELABEL(i2c1));

		if (device_is_ready(i2c)) {
			printk(" [PASS] I2C\n");
		} else {
			printk(" [FAIL] I2C - not ready\n");
		}
	}
#else
	printk(" [SKIP] I2C - not available\n");
#endif

#if DT_NODE_HAS_STATUS(DT_NODELABEL(spi1), okay)
	{
		const struct device *spi = DEVICE_DT_GET(DT_NODELABEL(spi1));

		if (device_is_ready(spi)) {
			printk(" [PASS] SPI\n");
		} else {
			printk(" [FAIL] SPI - not ready\n");
		}
	}
#else
	printk(" [SKIP] SPI - not available\n");
#endif

#if DT_HAS_COMPAT_STATUS_OKAY(jedec_spi_nor)
	{
		const struct device *flash =
			DEVICE_DT_GET(DT_COMPAT_GET_ANY_STATUS_OKAY(jedec_spi_nor));
		uint8_t id[3] = {0};

		if (!device_is_ready(flash)) {
			printk(" [FAIL] SPI NOR - not ready\n");
		} else if (flash_read_jedec_id(flash, id) != 0) {
			printk(" [FAIL] SPI NOR - JEDEC read-ID\n");
		} else {
			printk(" [PASS] SPI NOR JEDEC %02x %02x %02x\n",
			       id[0], id[1], id[2]);
		}
	}
#else
	printk(" [SKIP] SPI NOR - not in DT\n");
#endif

#if DT_NODE_EXISTS(DT_PATH(zephyr_user)) && \
	DT_NODE_HAS_PROP(DT_PATH(zephyr_user), io_channels)
	{
		static const struct adc_dt_spec adc_chan =
			ADC_DT_SPEC_GET_BY_IDX(DT_PATH(zephyr_user), 0);
		uint16_t sample_buf = 0;
		struct adc_sequence sequence = {
			.buffer = &sample_buf,
			.buffer_size = sizeof(sample_buf),
		};
		int err;
		int32_t val_mv;

		if (!adc_is_ready_dt(&adc_chan)) {
			printk(" [FAIL] ADC - not ready\n");
		} else if ((err = adc_channel_setup_dt(&adc_chan)) < 0) {
			printk(" [FAIL] ADC - channel setup (%d)\n", err);
		} else if ((err = adc_sequence_init_dt(&adc_chan, &sequence)) < 0) {
			printk(" [FAIL] ADC - sequence init (%d)\n", err);
		} else if ((err = adc_read_dt(&adc_chan, &sequence)) < 0) {
			printk(" [FAIL] ADC - read (%d)\n", err);
		} else {
			val_mv = sample_buf;
			if (adc_raw_to_millivolts_dt(&adc_chan, &val_mv) < 0) {
				printk(" [PASS] ADC ch%d raw=%u\n",
				       adc_chan.channel_id, sample_buf);
			} else {
				printk(" [PASS] ADC ch%d raw=%u (%d mV)\n",
				       adc_chan.channel_id, sample_buf, val_mv);
			}
		}
	}
#elif DT_NODE_HAS_STATUS(DT_NODELABEL(adc1), okay)
	{
		const struct device *adc = DEVICE_DT_GET(DT_NODELABEL(adc1));

		if (device_is_ready(adc)) {
			printk(" [PASS] ADC (ready; no io-channels)\n");
		} else {
			printk(" [FAIL] ADC - not ready\n");
		}
	}
#else
	printk(" [SKIP] ADC - not available\n");
#endif

#if DT_NODE_HAS_STATUS(DT_ALIAS(pwm_led0), okay)
	{
		static const struct pwm_dt_spec pwm =
			PWM_DT_SPEC_GET(DT_ALIAS(pwm_led0));
		const uint32_t period = PWM_MSEC(20);
		const uint32_t pulse = period / 2U;
		int err;

		if (!pwm_is_ready_dt(&pwm)) {
			printk(" [FAIL] PWM - not ready\n");
		} else if ((err = pwm_set_dt(&pwm, period, pulse)) != 0) {
			printk(" [FAIL] PWM - set (%d)\n", err);
		} else {
			printk(" [PASS] PWM ch%d %u/%u ns\n",
			       pwm.channel, pulse, period);
		}
	}
#elif DT_NODE_HAS_STATUS(DT_NODELABEL(pwm1), okay)
	{
		const struct device *pwm = DEVICE_DT_GET(DT_NODELABEL(pwm1));

		if (device_is_ready(pwm)) {
			printk(" [PASS] PWM (ready; no pwm-led0)\n");
		} else {
			printk(" [FAIL] PWM - not ready\n");
		}
	}
#else
	printk(" [SKIP] PWM - not available\n");
#endif

#if DT_HAS_CHOSEN(zephyr_display)
	{
		const struct device *disp = DEVICE_DT_GET(DT_CHOSEN(zephyr_display));

		if (!device_is_ready(disp)) {
			printk(" [FAIL] LCD - display not ready\n");
#if defined(CONFIG_LVGL)
		} else {
#if defined(CONFIG_ZPLATFORM_MB895_LCD)
			printk(" [PASS] LCD ID 0x%04x (%s) (LVGL owns panel)\n",
			       zplatform_mb895_lcd_id(),
			       zplatform_mb895_lcd_id_name(
				       zplatform_mb895_lcd_id()));
#else
			printk(" [PASS] LCD ready (LVGL owns panel)\n");
#endif
		}
#else /* !CONFIG_LVGL */
		} else {
			struct display_capabilities caps;
			struct display_buffer_descriptor desc;
			uint16_t line[ZPLATFORM_MB895_LCD_WIDTH];
			uint16_t color = ZPLATFORM_RGB565(0, 90, 180);
			int rc;
			bool ok = true;

			display_get_capabilities(disp, &caps);
			for (uint16_t i = 0; i < caps.x_resolution; i++) {
				line[i] = color;
			}
			desc.buf_size = sizeof(line);
			desc.width = caps.x_resolution;
			desc.height = 1;
			desc.pitch = caps.x_resolution;
			desc.frame_incomplete = false;

			for (uint16_t y = 0; y < caps.y_resolution; y++) {
				rc = display_write(disp, 0, y, &desc, line);
				if (rc < 0) {
					printk(" [FAIL] LCD display_write (%d)\n",
					       rc);
					ok = false;
					break;
				}
			}
			if (ok && display_blanking_off(disp) < 0) {
				printk(" [FAIL] LCD blanking_off\n");
				ok = false;
			}
			if (ok) {
#if defined(CONFIG_ZPLATFORM_MB895_LCD)
				printk(" [PASS] LCD ID 0x%04x (%s) display_write\n",
				       zplatform_mb895_lcd_id(),
				       zplatform_mb895_lcd_id_name(
					       zplatform_mb895_lcd_id()));
#else
				printk(" [PASS] LCD display_write %ux%u\n",
				       caps.x_resolution, caps.y_resolution);
#endif
			}
		}
#endif /* CONFIG_LVGL */
	}
#else
	printk(" [SKIP] LCD - no zephyr,display\n");
#endif

#if defined(CONFIG_ZPLATFORM_FSMC_SRAM)
	{
		int rc = zplatform_fsmc_sram_init();

		if (rc != 0) {
			printk(" [FAIL] FSMC SRAM init (%d)\n", rc);
#if defined(CONFIG_LVGL)
		} else {
			/* Selftest would wipe LVGL VDB/heap in EXT_SRAM. */
			printk(" [PASS] FSMC SRAM @ 0x%08x (LVGL buffers)\n",
			       ZPLATFORM_FSMC_SRAM_BASE);
#else
		} else if (zplatform_fsmc_sram_selftest(4096U) != 0) {
			printk(" [FAIL] FSMC SRAM selftest\n");
		} else {
			printk(" [PASS] FSMC SRAM @ 0x%08x selftest 4 KiB\n",
			       ZPLATFORM_FSMC_SRAM_BASE);
#endif
		}
	}
#else
	printk(" [SKIP] FSMC SRAM - not enabled\n");
#endif

#if defined(CONFIG_ZPLATFORM_SDIO_SD)
	{
		struct zplatform_sd_info info;
		uint8_t blk[ZPLATFORM_SD_BLOCK_SIZE] __aligned(4);
		int rc;

		if (!zplatform_sdio_sd_detected()) {
			printk(" [SKIP] microSD - not detected\n");
		} else if ((rc = zplatform_sdio_sd_init()) != 0) {
			printk(" [FAIL] microSD init (%d)\n", rc);
		} else if (zplatform_sdio_sd_get_info(&info) != 0) {
			printk(" [FAIL] microSD get_info\n");
		} else if (zplatform_sdio_sd_read(0, blk, 1) != 0) {
			printk(" [FAIL] microSD read LBA0\n");
		} else {
			printk(" [PASS] microSD %u blocks read LBA0\n",
			       info.log_block_nbr);
		}
	}
#else
	printk(" [SKIP] microSD - not enabled\n");
#endif

#if FIXED_PARTITION_EXISTS(storage_partition)
	printk(" [PASS] Flash (storage partition present)\n");
#elif defined(CONFIG_FLASH)
	printk(" [PASS] Flash (CONFIG_FLASH enabled)\n");
#else
	printk(" [SKIP] Flash - not available\n");
#endif

#if DT_HAS_COMPAT_STATUS_OKAY(lm75)
	{
		const struct device *dev =
			DEVICE_DT_GET(DT_COMPAT_GET_ANY_STATUS_OKAY(lm75));
		struct sensor_value val;

		if (device_is_ready(dev) &&
		    sensor_sample_fetch(dev) == 0 &&
		    sensor_channel_get(dev, SENSOR_CHAN_AMBIENT_TEMP, &val) == 0) {
			printk(" [PASS] Temperature sensor (%d.%06d C)\n",
			       val.val1, val.val2);
		} else if (device_is_ready(dev)) {
			printk(" [PASS] Temperature sensor (device ready; read needs HW)\n");
		} else {
			printk(" [FAIL] Temperature sensor\n");
		}
	}
#else
	printk(" [SKIP] Temperature sensor - not in DT\n");
#endif

#if DT_NODE_HAS_STATUS(DT_ALIAS(die_temp0), okay)
	{
		const struct device *dev = DEVICE_DT_GET(DT_ALIAS(die_temp0));
		struct sensor_value val;

		if (device_is_ready(dev) &&
		    sensor_sample_fetch(dev) == 0 &&
		    sensor_channel_get(dev, SENSOR_CHAN_DIE_TEMP, &val) == 0) {
			printk(" [PASS] Die temp (%d.%06d C)\n", val.val1,
			       val.val2);
		} else {
			printk(" [FAIL] Die temp\n");
		}
	}
#else
	printk(" [SKIP] Die temp - not in DT\n");
#endif

#if DT_NODE_HAS_STATUS(DT_NODELABEL(rtc), okay)
	{
		const struct device *rtc = DEVICE_DT_GET(DT_NODELABEL(rtc));
		uint32_t ticks = 0;
		int rc;

		if (!device_is_ready(rtc)) {
			printk(" [FAIL] RTC counter - not ready\n");
		} else if ((rc = counter_start(rtc)) < 0 && rc != -EALREADY) {
			printk(" [FAIL] RTC start (%d)\n", rc);
		} else if (counter_get_value(rtc, &ticks) != 0) {
			printk(" [FAIL] RTC get_value\n");
		} else {
			printk(" [PASS] RTC counter ticks=%u freq=%u\n", ticks,
			       counter_get_frequency(rtc));
		}
	}
#else
	printk(" [SKIP] RTC - not in DT\n");
#endif

#if DT_NODE_EXISTS(DT_PATH(zephyr_user)) && \
	DT_NODE_HAS_PROP(DT_PATH(zephyr_user), dac)
	{
		const struct device *dac =
			DEVICE_DT_GET(DT_PHANDLE(DT_PATH(zephyr_user), dac));
		const uint8_t ch =
			DT_PROP(DT_PATH(zephyr_user), dac_channel_id);
		struct dac_channel_cfg cfg = {
			.channel_id = ch,
			.resolution = DT_PROP(DT_PATH(zephyr_user),
					      dac_resolution),
			.buffered = true,
		};

		if (!device_is_ready(dac)) {
			printk(" [FAIL] DAC - not ready\n");
		} else if (dac_channel_setup(dac, &cfg) != 0) {
			printk(" [FAIL] DAC - setup\n");
		} else if (dac_write_value(dac, ch, 2048) != 0) {
			printk(" [FAIL] DAC - write\n");
		} else {
			printk(" [PASS] DAC ch%u mid-scale\n", ch);
		}
	}
#else
	printk(" [SKIP] DAC - not in DT\n");
#endif

#if DT_HAS_CHOSEN(zephyr_canbus)
	{
		const struct device *can =
			DEVICE_DT_GET(DT_CHOSEN(zephyr_canbus));
		struct can_frame tx = {
			.id = 0x321,
			.dlc = 1,
			.data = {0x42},
		};
		const struct can_filter filt = {
			.flags = 0,
			.id = 0x321,
			.mask = CAN_STD_ID_MASK,
		};
		struct can_frame rx;
		int fid;
		int rc;

		if (!device_is_ready(can)) {
			printk(" [FAIL] CAN - not ready\n");
		} else if ((rc = can_set_mode(can, CAN_MODE_LOOPBACK)) != 0) {
			printk(" [FAIL] CAN mode (%d)\n", rc);
		} else if ((rc = can_start(can)) != 0) {
			printk(" [FAIL] CAN start (%d)\n", rc);
		} else if ((fid = can_add_rx_filter_msgq(can, &demo_can_rx,
							 &filt)) < 0) {
			printk(" [FAIL] CAN filter (%d)\n", fid);
		} else if ((rc = can_send(can, &tx, K_MSEC(100), NULL, NULL)) !=
			   0) {
			printk(" [FAIL] CAN send (%d)\n", rc);
		} else if (k_msgq_get(&demo_can_rx, &rx, K_MSEC(100)) != 0) {
			printk(" [FAIL] CAN RX timeout\n");
		} else {
			printk(" [PASS] CAN loopback id=0x%X\n", rx.id);
		}
	}
#else
	printk(" [SKIP] CAN - not chosen (see samples/can)\n");
#endif

	printk(" [SKIP] USB CDC - samples/usb_cdc (IRQ share with CAN)\n");
	printk(" [SKIP] FSMC NAND/NOR / Audio AK4343 / Smartcard / IrDA\n");
	printk("\n");
}
```
