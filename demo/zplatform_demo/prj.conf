## CMakeLists.txt
```
cmake_minimum_required(VERSION 3.20.0)
find_package(Zephyr REQUIRED HINTS $ENV{ZEPHYR_BASE})
project(zplatform_demo)

target_sources(app PRIVATE
  src/main.c
  src/demo_gpio.c
  src/demo_peripherals.c
  src/demo_diag.c
)
```

## sample.yaml
```
sample:
  name: ZPlatform full demo
tests:
  demo.zplatform:
    tags: zplatform demo
    platform_allow:
      - stm3210e_eval
    harness: console
    harness_config:
      type: multi_line
      regex:
        - "ZPlatform Demo"
        - "ZPlatform ready"
```

## prj.conf
```kconfig
# Copyright (c) 2026 ZPlatform contributors
# SPDX-License-Identifier: Apache-2.0

CONFIG_GPIO=y
CONFIG_SERIAL=y
CONFIG_CONSOLE=y
CONFIG_UART_CONSOLE=y
CONFIG_UART_INTERRUPT_DRIVEN=y
CONFIG_SHELL=y
CONFIG_SHELL_BACKEND_SERIAL=y
CONFIG_LOG=y
CONFIG_LOG_DEFAULT_LEVEL=3
CONFIG_I2C=y
CONFIG_SPI=y
CONFIG_ADC=y
CONFIG_PWM=y
CONFIG_SENSOR=y
CONFIG_LM75=y
CONFIG_FLASH=y
CONFIG_FLASH_MAP=y
CONFIG_FLASH_PAGE_LAYOUT=y
CONFIG_THREAD_MONITOR=y
CONFIG_INIT_STACKS=y
CONFIG_THREAD_STACK_INFO=y
CONFIG_ZPLATFORM=y
CONFIG_ZPLATFORM_LIB_COMMON=y
CONFIG_ZPLATFORM_LIB_DIAGNOSTICS=y
CONFIG_ZPLATFORM_SHELL=y
CONFIG_MAIN_STACK_SIZE=2048
CONFIG_IDLE_STACK_SIZE=512
CONFIG_SHELL_STACK_SIZE=2048
```

## src/main.c
```c
/*
 * Copyright (c) 2026 ZPlatform contributors
 * SPDX-License-Identifier: Apache-2.0
 */

#include <zephyr/kernel.h>
#include <zephyr/sys/printk.h>
#include <zephyr/version.h>

#include <zplatform/info.h>

#include "demo_internal.h"

int main(void)
{
	struct zplatform_sys_info info;

	printk("========================================\n");
	printk(" ZPlatform Demo\n");
	if (zplatform_get_sys_info(&info) == 0) {
		printk(" %s\n", info.board);
	}
	printk("========================================\n\n");

	printk("System\n");
	printk(" [PASS] Boot\n");
	printk(" [PASS] Clock (%u Hz)\n",
	       info.cpu_freq_hz ? info.cpu_freq_hz : sys_clock_hw_cycles_per_sec());
	printk(" [PASS] Kernel (%s)\n", KERNEL_VERSION_STRING);
	printk(" [PASS] Console\n\n");

	demo_run_gpio();
	demo_run_peripherals();
	demo_run_diagnostics();

	printk("\nZPlatform ready.\n");
	printk("========================================\n");
	printk("Shell available. Try: zplatform info\n");

	return 0;
}
```

## src/demo_diag.c
```c
/*
 * Copyright (c) 2026 ZPlatform contributors
 * SPDX-License-Identifier: Apache-2.0
 */

#include <zephyr/kernel.h>
#include <zephyr/sys/printk.h>

#include <zplatform/info.h>
#include <zplatform/diag.h>

#include "demo_internal.h"

void demo_run_diagnostics(void)
{
	struct zplatform_sys_info info;

	if (zplatform_get_sys_info(&info) == 0) {
		printk("System details\n");
		printk(" MCU board: %s\n", info.board);
		printk(" CPU frequency: %u Hz\n", info.cpu_freq_hz);
		printk(" Flash size: %u\n", info.flash_size);
		printk(" RAM size: %u\n", info.sram_size);
		printk(" ZPlatform: %s\n", info.zplatform_version);
		printk(" Zephyr: %s\n", info.zephyr_version);
		printk("\n");
	}

	zplatform_diag_report();
}
```

## src/demo_gpio.c
```c
/*
 * Copyright (c) 2026 ZPlatform contributors
 * SPDX-License-Identifier: Apache-2.0
 */

#include <zephyr/kernel.h>
#include <zephyr/drivers/gpio.h>
#include <zephyr/sys/printk.h>

#include "demo_internal.h"

static const struct gpio_dt_spec led = GPIO_DT_SPEC_GET_OR(DT_ALIAS(led0), gpios, {0});
static const struct gpio_dt_spec button = GPIO_DT_SPEC_GET_OR(DT_ALIAS(sw0), gpios, {0});

void demo_run_gpio(void)
{
	printk("GPIO\n");

	if (led.port && gpio_is_ready_dt(&led) &&
	    gpio_pin_configure_dt(&led, GPIO_OUTPUT_ACTIVE) == 0) {
		printk(" [PASS] LED\n");
		gpio_pin_set_dt(&led, 1);
	} else {
		printk(" [SKIP] LED - not available\n");
	}

	if (button.port && gpio_is_ready_dt(&button) &&
	    gpio_pin_configure_dt(&button, GPIO_INPUT) == 0) {
		int state = gpio_pin_get_dt(&button);

		printk(" [PASS] USER BUTTON (raw=%d)\n", state);
	} else {
		printk(" [SKIP] USER BUTTON - not available\n");
	}

	printk("\n");
}
```

## src/demo_internal.h
```c
/*
 * Copyright (c) 2026 ZPlatform contributors
 * SPDX-License-Identifier: Apache-2.0
 */

#ifndef DEMO_INTERNAL_H_
#define DEMO_INTERNAL_H_

void demo_run_gpio(void);
void demo_run_peripherals(void);
void demo_run_diagnostics(void);

#endif /* DEMO_INTERNAL_H_ */
```

## src/demo_peripherals.c
```c
/*
 * Copyright (c) 2026 ZPlatform contributors
 * SPDX-License-Identifier: Apache-2.0
 */

#include <zephyr/kernel.h>
#include <zephyr/device.h>
#include <zephyr/drivers/i2c.h>
#include <zephyr/drivers/spi.h>
#include <zephyr/drivers/adc.h>
#include <zephyr/drivers/pwm.h>
#include <zephyr/drivers/sensor.h>
#include <zephyr/storage/flash_map.h>
#include <zephyr/sys/printk.h>

#include "demo_internal.h"

void demo_run_peripherals(void)
{
	printk("Peripherals\n");

#if DT_NODE_HAS_STATUS(DT_NODELABEL(i2c1), okay)
	{
		const struct device *i2c = DEVICE_DT_GET(DT_NODELABEL(i2c1));

		if (device_is_ready(i2c)) {
			printk(" [PASS] I2C\n");
		} else {
			printk(" [FAIL] I2C - not ready\n");
		}
	}
#else
	printk(" [SKIP] I2C - not available\n");
#endif

#if DT_NODE_HAS_STATUS(DT_NODELABEL(spi1), okay)
	{
		const struct device *spi = DEVICE_DT_GET(DT_NODELABEL(spi1));

		if (device_is_ready(spi)) {
			printk(" [PASS] SPI\n");
		} else {
			printk(" [FAIL] SPI - not ready\n");
		}
	}
#else
	printk(" [SKIP] SPI - not available\n");
#endif

#if DT_NODE_HAS_STATUS(DT_NODELABEL(adc1), okay)
	{
		const struct device *adc = DEVICE_DT_GET(DT_NODELABEL(adc1));

		if (device_is_ready(adc)) {
			printk(" [PASS] ADC\n");
		} else {
			printk(" [FAIL] ADC - not ready\n");
		}
	}
#else
	printk(" [SKIP] ADC - not available\n");
#endif

#if DT_NODE_HAS_STATUS(DT_NODELABEL(pwm1), okay)
	{
		const struct device *pwm = DEVICE_DT_GET(DT_NODELABEL(pwm1));

		if (device_is_ready(pwm)) {
			printk(" [PASS] PWM\n");
		} else {
			printk(" [FAIL] PWM - not ready\n");
		}
	}
#else
	printk(" [SKIP] PWM - not available\n");
#endif

#if FIXED_PARTITION_EXISTS(storage_partition)
	printk(" [PASS] Flash (storage partition present)\n");
#elif defined(CONFIG_FLASH)
	printk(" [PASS] Flash (CONFIG_FLASH enabled)\n");
#else
	printk(" [SKIP] Flash - not available\n");
#endif

#if DT_HAS_COMPAT_STATUS_OKAY(lm75)
	{
		const struct device *dev =
			DEVICE_DT_GET(DT_COMPAT_GET_ANY_STATUS_OKAY(lm75));
		struct sensor_value val;

		if (device_is_ready(dev) &&
		    sensor_sample_fetch(dev) == 0 &&
		    sensor_channel_get(dev, SENSOR_CHAN_AMBIENT_TEMP, &val) == 0) {
			printk(" [PASS] Temperature sensor (%d.%06d C)\n",
			       val.val1, val.val2);
		} else if (device_is_ready(dev)) {
			printk(" [PASS] Temperature sensor (device ready; read needs HW)\n");
		} else {
			printk(" [FAIL] Temperature sensor\n");
		}
	}
#else
	printk(" [SKIP] Temperature sensor - not in DT\n");
#endif

	printk(" [SKIP] Ethernet - not available on STM32F103\n");
	printk("\n");
}
```
